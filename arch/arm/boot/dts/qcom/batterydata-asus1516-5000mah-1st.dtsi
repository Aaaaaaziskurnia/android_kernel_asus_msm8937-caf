
qcom,2880495_huaqin_c11p1612cos_5000mah_averaged_masterslave_apr17th2017 {
	/* #2880495_Huaqin_C11P1612cos_5000mAh_averaged_MasterSlave_Apr17th2017*/
	qcom,max-voltage-uv = <4400000>;
	qcom,nom-batt-capacity-mah = <5000>;
	qcom,batt-id-kohm = <51>;
	qcom,battery-beta = <3435>;
	qcom,battery-type = "C11P1612-O-01-0001-14.2016.1703.120";
	qcom,thermal-coefficients = [C5 86 BE 50 D1 37];
	qcom,chg-rslow-comp-c1 = <3827095>;
	qcom,chg-rslow-comp-c2 = <6543793>;
	qcom,chg-rs-to-rslow = <798345>;
	qcom,chg-rslow-comp-thr = <0xB5>;
	qcom,checksum = <0x3CDD>;
	qcom,gui-version = "PMI8950GUI - 2.0.0.16";
	qcom,fg-profile-data = [
		 F6 83 B3 7D 
		 B3 81 29 7C 
		 5E 83 BF 6C 
		 C3 83 4A 8E 
		 2D 82 DE 99 
		 DD BC 71 C9 
		 5A 0E 06 88 
		 E0 7D 9D 81 
		 D0 77 53 83 
		 B5 6A 43 78 
		 FB 85 52 82 
		 A6 99 FB BC 
		 EF C9 5A 0D 
		 E2 13 40 59 
		 14 70 29 FC 
		 47 3D F7 44 
		 8E 3A 00 00 
		 66 45 A2 38 
		 8D 36 00 00 
		 00 00 00 00 
		 00 00 00 00 
		 63 6A 41 69 
		 2B 61 FE 82 
		 6B 74 41 6A 
		 53 68 94 80 
		 7F 6D ED 62 
		 FF 5C 78 AA 
		 1D 7A 62 7D 
		 64 A0 71 0C 
		 28 00 FF 36 
		 F0 11 30 03 
		 00 00 00 0C 
	];
	
	huaq,high-float-voltage-comp = <16>;
	huaq,low-float-voltage-comp = <1>;
	huaq,high-fastchg-current-comp = <1200>;
	huaq,low-fastchg-current-comp = <1200>;

};
