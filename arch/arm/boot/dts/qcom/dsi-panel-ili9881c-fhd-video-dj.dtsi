/* Copyright (c) 2015-2016, The Linux Foundation. All rights reserved.
 *
 * This program is free software; you can redistribute it and/or modify
 * it under the terms of the GNU General Public License version 2 and
 * only version 2 as published by the Free Software Foundation.
 *
 * This program is distributed in the hope that it will be useful,
 * but WITHOUT ANY WARRANTY; without even the implied warranty of
 * MERCHANTABILITY or FITNESS FOR A PARTICULAR PURPOSE.  See the
 * GNU General Public License for more details.
 */

&mdss_mdp {
	dsi_ili9881c_fhd_vid: qcom,mdss_dsi_ili9881c_fhd_video_dj {
		qcom,mdss-dsi-panel-name = "ili9881c fhd video mode dsi panel";
		qcom,mdss-dsi-panel-controller = <&mdss_dsi0>;
		qcom,mdss-dsi-panel-type = "dsi_video_mode";
		qcom,mdss-dsi-panel-framerate = <60>;
		qcom,mdss-dsi-virtual-channel-id = <0>;
		qcom,mdss-dsi-stream = <0>;
		qcom,mdss-dsi-panel-orientation = "180";
		qcom,mdss-dsi-panel-width = <720>;
		qcom,mdss-dsi-panel-height = <1280>;

		qcom,mdss-pan-physical-width-dimension = <68>;
		qcom,mdss-pan-physical-height-dimension = <121>;

		qcom,mdss-dsi-h-front-porch = <152>;
		qcom,mdss-dsi-h-back-porch = <12>;
		qcom,mdss-dsi-h-pulse-width = <8>;
		qcom,mdss-dsi-h-sync-skew = <0>;
		qcom,mdss-dsi-v-back-porch = <18>;
		qcom,mdss-dsi-v-front-porch = <8>;
		qcom,mdss-dsi-v-pulse-width = <4>;
		qcom,mdss-dsi-h-left-border = <0>;
		qcom,mdss-dsi-h-right-border = <0>;
		qcom,mdss-dsi-v-top-border = <0>;
		qcom,mdss-dsi-v-bottom-border = <0>;
		qcom,mdss-dsi-bpp = <24>;
		qcom,mdss-dsi-underflow-color = <0xff>;
		qcom,mdss-dsi-border-color = <0>;
		qcom,mdss-dsi-h-sync-pulse = <0>;
		qcom,mdss-dsi-traffic-mode = "burst_mode";
		qcom,mdss-dsi-bllp-eof-power-mode;
		qcom,mdss-dsi-bllp-power-mode;
		qcom,mdss-dsi-lane-map = "lane_map_0123";
		qcom,mdss-dsi-lane-0-state;
		qcom,mdss-dsi-lane-1-state;
		qcom,mdss-dsi-lane-2-state;
		qcom,mdss-dsi-lane-3-state;
		qcom,mdss-dsi-panel-timings = [7B 1A 10 00 3E 40 16 1E 15 03 04 00];
		qcom,mdss-dsi-t-clk-post = <0x04>;
		qcom,mdss-dsi-t-clk-pre = <0x1A>;
		qcom,mdss-dsi-bl-min-level = <1>;
		qcom,mdss-dsi-bl-max-level = <4095>;
		qcom,mdss-dsi-dma-trigger = "trigger_sw";
		qcom,mdss-dsi-mdp-trigger = "none";

		qcom,mdss-dsi-on-command = [39 01 00 00 00 00 04 ff 98 81 03
			39 01 00 00 00 00 02 01 00
			39 01 00 00 00 00 02 02 00
			39 01 00 00 00 00 02 03 56
			39 01 00 00 00 00 02 04 13
			39 01 00 00 00 00 02 05 00
			39 01 00 00 00 00 02 06 06
			39 01 00 00 00 00 02 07 01
			39 01 00 00 00 00 02 08 00
			39 01 00 00 00 00 02 09 30
			39 01 00 00 00 00 02 0a 01
			39 01 00 00 00 00 02 0b 00
			39 01 00 00 00 00 02 0c 30
			39 01 00 00 00 00 02 0d 01
			39 01 00 00 00 00 02 0e 00
			39 01 00 00 00 00 02 0f 18
			39 01 00 00 00 00 02 10 18
			39 01 00 00 00 00 02 11 00
			39 01 00 00 00 00 02 12 00
			39 01 00 00 00 00 02 13 00
			39 01 00 00 00 00 02 14 00
			39 01 00 00 00 00 02 15 00
			39 01 00 00 00 00 02 16 00
			39 01 00 00 00 00 02 17 00
			39 01 00 00 00 00 02 18 00
			39 01 00 00 00 00 02 19 00
			39 01 00 00 00 00 02 1a 00
			39 01 00 00 00 00 02 1b 00
			39 01 00 00 00 00 02 1c 00
			39 01 00 00 00 00 02 1d 00
			39 01 00 00 00 00 02 1e 40
			39 01 00 00 00 00 02 1f c0
			39 01 00 00 00 00 02 20 02
			39 01 00 00 00 00 02 21 05
			39 01 00 00 00 00 02 22 02
			39 01 00 00 00 00 02 23 00
			39 01 00 00 00 00 02 24 86
			39 01 00 00 00 00 02 25 85
			39 01 00 00 00 00 02 26 00
			39 01 00 00 00 00 02 27 00
			39 01 00 00 00 00 02 28 3b
			39 01 00 00 00 00 02 29 03
			39 01 00 00 00 00 02 2a 00
			39 01 00 00 00 00 02 2b 00
			39 01 00 00 00 00 02 2c 00
			39 01 00 00 00 00 02 2d 00
			39 01 00 00 00 00 02 2e 00
			39 01 00 00 00 00 02 2f 00
			39 01 00 00 00 00 02 30 00
			39 01 00 00 00 00 02 31 00
			39 01 00 00 00 00 02 32 00
			39 01 00 00 00 00 02 33 00
			39 01 00 00 00 00 02 34 00
			39 01 00 00 00 00 02 35 00
			39 01 00 00 00 00 02 36 00
			39 01 00 00 00 00 02 37 00
			39 01 00 00 00 00 02 38 00
			39 01 00 00 00 00 02 39 00
			39 01 00 00 00 00 02 3a 00
			39 01 00 00 00 00 02 3b 00
			39 01 00 00 00 00 02 3c 00
			39 01 00 00 00 00 02 3d 00
			39 01 00 00 00 00 02 3e 00
			39 01 00 00 00 00 02 3f 00
			39 01 00 00 00 00 02 40 00
			39 01 00 00 00 00 02 41 00
			39 01 00 00 00 00 02 42 00
			39 01 00 00 00 00 02 43 00
			39 01 00 00 00 00 02 44 00
			39 01 00 00 00 00 02 50 01
			39 01 00 00 00 00 02 51 23
			39 01 00 00 00 00 02 52 45
			39 01 00 00 00 00 02 53 67
			39 01 00 00 00 00 02 54 89
			39 01 00 00 00 00 02 55 ab
			39 01 00 00 00 00 02 56 01
			39 01 00 00 00 00 02 57 23
			39 01 00 00 00 00 02 58 45
			39 01 00 00 00 00 02 59 67
			39 01 00 00 00 00 02 5a 89
			39 01 00 00 00 00 02 5b ab
			39 01 00 00 00 00 02 5c cd
			39 01 00 00 00 00 02 5d ef
			39 01 00 00 00 00 02 5e 11
			39 01 00 00 00 00 02 5f 08
			39 01 00 00 00 00 02 60 00
			39 01 00 00 00 00 02 61 01
			39 01 00 00 00 00 02 62 02
			39 01 00 00 00 00 02 63 02
			39 01 00 00 00 00 02 64 0f
			39 01 00 00 00 00 02 65 0e
			39 01 00 00 00 00 02 66 0d
			39 01 00 00 00 00 02 67 0c
			39 01 00 00 00 00 02 68 02
			39 01 00 00 00 00 02 69 02
			39 01 00 00 00 00 02 6a 02
			39 01 00 00 00 00 02 6b 02
			39 01 00 00 00 00 02 6c 02
			39 01 00 00 00 00 02 6d 02
			39 01 00 00 00 00 02 6e 06
			39 01 00 00 00 00 02 6f 02
			39 01 00 00 00 00 02 70 02
			39 01 00 00 00 00 02 71 02
			39 01 00 00 00 00 02 72 02
			39 01 00 00 00 00 02 73 02
			39 01 00 00 00 00 02 74 02
			39 01 00 00 00 00 02 75 06
			39 01 00 00 00 00 02 76 00
			39 01 00 00 00 00 02 77 01
			39 01 00 00 00 00 02 78 02
			39 01 00 00 00 00 02 79 02
			39 01 00 00 00 00 02 7a 0f
			39 01 00 00 00 00 02 7b 0e
			39 01 00 00 00 00 02 7c 0d
			39 01 00 00 00 00 02 7d 0c
			39 01 00 00 00 00 02 7e 02
			39 01 00 00 00 00 02 7f 02
			39 01 00 00 00 00 02 80 02
			39 01 00 00 00 00 02 81 02
			39 01 00 00 00 00 02 82 02
			39 01 00 00 00 00 02 83 02
			39 01 00 00 00 00 02 84 08
			39 01 00 00 00 00 02 85 02
			39 01 00 00 00 00 02 86 02
			39 01 00 00 00 00 02 87 02
			39 01 00 00 00 00 02 88 02
			39 01 00 00 00 00 02 89 02
			39 01 00 00 00 00 02 8a 02

			39 01 00 00 00 00 04 ff 98 81 04
			39 01 00 00 00 00 02 00 80
			39 01 00 00 00 00 02 6c 15
			39 01 00 00 00 00 02 6e 2b
			39 01 00 00 00 00 02 6f 33
			39 01 00 00 00 00 02 3a a4
			39 01 00 00 00 00 02 8d 15
			39 01 00 00 00 00 02 87 ba
			39 01 00 00 00 00 02 26 76
			39 01 00 00 00 00 02 b2 d1
			39 01 00 00 00 00 02 b5 06

			39 01 00 00 00 00 04 ff 98 81 01
			39 01 00 00 00 00 02 22 0a
			39 01 00 00 00 00 02 31 00
			39 01 00 00 00 00 02 50 b7
			39 01 00 00 00 00 02 51 b7
			39 01 00 00 00 00 02 60 30
			39 01 00 00 00 00 02 61 00
			39 01 00 00 00 00 02 62 19
			39 01 00 00 00 00 02 63 10

			39 01 00 00 00 00 02 a0 10
			39 01 00 00 00 00 02 a1 2a
			39 01 00 00 00 00 02 a2 39
			39 01 00 00 00 00 02 a3 15
			39 01 00 00 00 00 02 a4 18
			39 01 00 00 00 00 02 a5 2a
			39 01 00 00 00 00 02 a6 1e
			39 01 00 00 00 00 02 a7 20
			39 01 00 00 00 00 02 a8 a2
			39 01 00 00 00 00 02 a9 1c
			39 01 00 00 00 00 02 aa 28
			39 01 00 00 00 00 02 ab 90
			39 01 00 00 00 00 02 ac 1c
			39 01 00 00 00 00 02 ad 19
			39 01 00 00 00 00 02 ae 4e
			39 01 00 00 00 00 02 af 23
			39 01 00 00 00 00 02 b0 29
			39 01 00 00 00 00 02 b1 59
			39 01 00 00 00 00 02 b2 69
			39 01 00 00 00 00 02 b3 39

			39 01 00 00 00 00 02 c0 00
			39 01 00 00 00 00 02 c1 2a
			39 01 00 00 00 00 02 c2 39
			39 01 00 00 00 00 02 c3 15
			39 01 00 00 00 00 02 c4 18
			39 01 00 00 00 00 02 c5 2a
			39 01 00 00 00 00 02 c6 1f
			39 01 00 00 00 00 02 c7 1f
			39 01 00 00 00 00 02 c8 a3
			39 01 00 00 00 00 02 c9 1b
			39 01 00 00 00 00 02 ca 28
			39 01 00 00 00 00 02 cb 90
			39 01 00 00 00 00 02 cc 1b
			39 01 00 00 00 00 02 cd 1a
			39 01 00 00 00 00 02 ce 4d
			39 01 00 00 00 00 02 cf 22
			39 01 00 00 00 00 02 d0 28
			39 01 00 00 00 00 02 d1 59
			39 01 00 00 00 00 02 d2 69
			39 01 00 00 00 00 02 d3 39

			39 01 00 00 00 00 04 ff 98 81 00
			05 01 00 00 78 00 02 11 00
			05 01 00 00 14 00 02 29 00
			05 01 00 00 00 00 02 35 00];

		qcom,mdss-dsi-off-command = [05 01 00 00 14 00 02 28 00
				 05 01 00 00 78 00 02 10 00];
		qcom,mdss-dsi-on-command-state = "dsi_lp_mode";
		qcom,mdss-dsi-off-command-state = "dsi_lp_mode";
		qcom,mdss-dsi-bl-pmic-control-type = "bl_ctrl_wled";
		qcom,mdss-dsi-reset-sequence = <1 2>, <0 2>, <1 15>;

		qcom,esd-check-enabled;
		qcom,mdss-dsi-panel-status-command      = [06 01 00 01 05 00 01 0A
			06 01 00 01 05 00 01 09];
		qcom,mdss-dsi-panel-status-command-mode = "dsi_lp_mpde";
		qcom,mdss-dsi-panel-status-check-mode   = "reg_read";
		qcom,mdss-dsi-panel-status-read-length  = <1 3>;
		qcom,mdss-dsi-panel-status-valid-params = <1 3>;
		qcom,mdss-dsi-panel-status-value        = <0x9C 0x80 0x03 0x06>;
		qcom,mdss-dsi-panel-max-error-count     = <3>;

		//qcom,mdss-dsi-tx-eot-append;
		//qcom,mdss-dsi-post-init-delay = <8>;
		qcom,mdss-dsi-lp11-init;
		//qcom,mdss-dsi-init-delay-us = <50000>;
	};
};
