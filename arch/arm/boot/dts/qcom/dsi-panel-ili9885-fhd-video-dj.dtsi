/* Copyright (c) 2015-2016, The Linux Foundation. All rights reserved.
 *
 * This program is free software; you can redistribute it and/or modify
 * it under the terms of the GNU General Public License version 2 and
 * only version 2 as published by the Free Software Foundation.
 *
 * This program is distributed in the hope that it will be useful,
 * but WITHOUT ANY WARRANTY; without even the implied warranty of
 * MERCHANTABILITY or FITNESS FOR A PARTICULAR PURPOSE.  See the
 * GNU General Public License for more details.
 */

&mdss_mdp {
	dsi_ili9885_fhd_vid: qcom,mdss_dsi_ili9885_fhd_video_dj {
		qcom,mdss-dsi-panel-name = "ili9885 fhd video mode dsi panel";
		qcom,mdss-dsi-panel-controller = <&mdss_dsi0>;
		qcom,mdss-dsi-panel-type = "dsi_video_mode";
		qcom,mdss-dsi-panel-framerate = <60>;
		qcom,mdss-dsi-panel-orientation = "180";
		qcom,mdss-dsi-virtual-channel-id = <0>;
		qcom,mdss-dsi-stream = <0>;
		qcom,mdss-dsi-panel-width = <1080>;
		qcom,mdss-dsi-panel-height = <1920>;
		qcom,mdss-dsi-h-front-porch = <152>;
		qcom,mdss-dsi-h-back-porch = <12>;
		qcom,mdss-dsi-h-pulse-width = <8>;
		qcom,mdss-dsi-h-sync-skew = <0>;
		qcom,mdss-dsi-v-back-porch = <18>;
		qcom,mdss-dsi-v-front-porch = <4>;
		qcom,mdss-dsi-v-pulse-width = <4>;
		qcom,mdss-dsi-h-left-border = <0>;
		qcom,mdss-dsi-h-right-border = <0>;
		qcom,mdss-dsi-v-top-border = <0>;
		qcom,mdss-dsi-v-bottom-border = <0>;
		qcom,mdss-dsi-bpp = <24>;
		qcom,mdss-dsi-underflow-color = <0xff>;
		qcom,mdss-dsi-border-color = <0>;
		qcom,mdss-dsi-h-sync-pulse = <0>;
		qcom,mdss-dsi-traffic-mode = "burst_mode";
		qcom,mdss-dsi-bllp-eof-power-mode;
		qcom,mdss-dsi-bllp-power-mode;
		qcom,mdss-dsi-lane-map = "lane_map_0123";
		qcom,mdss-dsi-lane-0-state;
		qcom,mdss-dsi-lane-1-state;
		qcom,mdss-dsi-lane-2-state;
		qcom,mdss-dsi-lane-3-state;
		qcom,mdss-dsi-panel-timings = [6f 36 24 00 66 6a 2a 3a 2d 03 04 00];
		qcom,mdss-dsi-t-clk-post = <0x1e>;
		qcom,mdss-dsi-t-clk-pre = <0x38>;
		qcom,mdss-dsi-bl-min-level = <1>;
		qcom,mdss-dsi-bl-max-level = <4095>;
		qcom,mdss-dsi-dma-trigger = "trigger_sw";
		qcom,mdss-dsi-mdp-trigger = "none";
		qcom,mdss-dsi-on-command = [39 01 00 00 00 00 04 B0 98 85 0A
				39 01 00 00 00 00 08 C4 70 19 23 00 0F 0F 00
				39 01 00 00 00 00 10 D0 33 05 21 E7 62 00 88 A0 A0 03 02 80 D0 1B 10
				39 01 00 00 00 00 03
 D1 00 00
				39 01 00 00 00 00 05 D2 03 03 2A 22
				39 01 00 00 00 00 0C D3 44 33 05 03 4A 4A 33 17 22 43 6E
				39 01 00 00 00 00 0D D6 80 00 08 17 23 65 77 44 87 00 00 09
				39 01 00 00 00 00 08 EC 76 1E 32 00 46 00 02
				39 01 00 00 00 00 02 EF 8F
				39 01 00 00 00 00 02 35 00
				39 01 00 00 00 00 7B C7 00 0F 00 1E 00 38 00 4E 00 61 00 73 00 82 00 91 00 9E 00 CC 00 F2 01 2F 01 5F 01 AB 01 E9 01 EB 02 23 02 60 02 88 02 C1 02 E8 03 19 03 27 03 37 03 48 03 59 03 6A 03 75 03 7C 03 87 00 0F 00 1E 00 38 00 4E 00 61 00 73 00 82 00 91 00 9E 00 CC 00 F2 01 2F 01 5F 01 AB 01 E9 01 EB 02 23 02 60 02 88 02 C1 02 E8 03 19 03 27 03 37 03 48 03 59 03 6A 03 75 03 7C 03 87 01 01
				39 01 00 00 00 00 4A E5 6D 92 80 34 76 12 12 00 00 36 36 24 24 26 F6 F6 F6 F6 F6 F6 6D 9B 89 34 76 1B 1B 09 09 3F 3F 2D 2D 26 F6 F6 F6 F6 F6 F6 04 40 90 00 D6 00 00 00 00 01 01 44 00 D6 00 00 00 00 00 00 00 00 00 00 00 03 03 03 03 03 03 00 07
				39 01 00 00 00 00 43 EA 70 00 03 03 00 00 00 40 00 00 00 00 00 00 0b 00 00 00 89 8a 05 05 22 0a 0a 0b 00 08 00 30 01 09 00 40 80 c0 00 00 01 23 45 67 89 ab cd ef DD 22 22 CC DD 00 00 00 00 00 00 00 00 CC 33 33 33 33 33 33
				39 01 00 00 00 00 03 EE 22 10
				39 01 00 00 00 00 18 ED 00 01 00 00 00 00 00 00 00 00 00 00 00 00 00 00 00 00 00 00 00 00 e0
				39 01 00 00 00 00 21 EB a3 cf 73 18 54 55 55 55 55 00 55 55 55 55 55 25 0D 0F 00 00 00 00 00 55 55 55 55 32 3E 55 43 55
				05 01 00 00 00 00 02 B0 11
				05 01 00 00 78 00 02 11 00
				05 01 00 00 0A 00 02 29 00
				39 01 00 00 00 00 04 B0 98 85 0A
				39 01 00 00 00 00 06 D7 00 00 00 81 07
				39 01 00 00 00 00 02 B0 11];
		qcom,mdss-dsi-off-command = [05 01 00 00 14 00 02 28 00
				 05 01 00 00 78 00 02 10 00];
		qcom,mdss-dsi-on-command-state = "dsi_lp_mode";
		qcom,mdss-dsi-off-command-state = "dsi_lp_mode";
		qcom,mdss-dsi-bl-pmic-control-type = "bl_ctrl_wled";
		qcom,mdss-dsi-reset-sequence = <1 20>, <0 20>, <1 120>;
		//qcom,mdss-dsi-tx-eot-append;
		//qcom,mdss-dsi-post-init-delay = <8>;
		//qcom,mdss-dsi-lp11-init;
		//qcom,mdss-dsi-init-delay-us = <50000>;
	};
};
