## drivers/input/fingerprint/Kconfig
```kconfig
#
# Touchscreen driver configuration
#
menuconfig INPUT_FINGERPRINT
	bool "Fingerprint"
	help
	  Say Y here, and a list of supported fingerprint will be displayed.
	  This option doesn't affect the kernel.

	  If unsure, say Y.

if INPUT_TOUCHSCREEN

config GOODIX_FP
	bool "GOODIX_FP for Qualcomm package"
	help
	  Say Y here if you have a goodix fingerprint.

          If unsure, say N.

config FINGERPRINT_FOCALTECH_FT9338
	bool "FINGERPRINT_FOCALTECH_FT9338 for Qualcomm package"
	help
	  Say Y here if you have a focaltech fingerprint.

          If unsure, say N.

endif
```

## drivers/input/fingerprint/focaltech/Kconfig
```kconfig
config FINGERPRINT_FOCALTECH_FT9338
	tristate "Focaltech FT9338/FT9336 fingerprint drvier support"
	help
	  Say Y here to enable focaltech fingerprint driver support!  
```
